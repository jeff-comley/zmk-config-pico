## config/boards/shields/picopad/Kconfig.defconfig
```kconfig
if PICOPAD

config ZMK_KEYBOARD_NAME
    default "Pico Pad"



if ZMK_DISPLAY

config I2C
    default y

config SSD1306
    default y

config SSD1306_REVERSE_MODE
    default y

endif # ZMK_DISPLAY
```
