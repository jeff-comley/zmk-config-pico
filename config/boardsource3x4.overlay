/*
 * Copyright (c) 2020 The ZMK Contributors
 *
 * SPDX-License-Identifier: MIT
 */

#include <dt-bindings/zmk/matrix_transform.h>

/ {
    chosen {
        zmk,kscan = &kscan0;
    };

    kscan0: kscan {
        compatible = "zmk,kscan-gpio-matrix";
        label = "KSCAN";
        diode-direction = "col2row";

         row-gpios
            = <&rpi_pico 10 (GPIO_ACTIVE_HIGH | GPIO_PULL_DOWN)>
            , <&rpi_pico 11 (GPIO_ACTIVE_HIGH | GPIO_PULL_DOWN)>
            ;

        col-gpios
            = <&rpi_pico 0 GPIO_ACTIVE_HIGH>
            , <&rpi_pico 1 GPIO_ACTIVE_HIGH>
            , <&rpi_pico 2 GPIO_ACTIVE_HIGH>
            ;
    };
};